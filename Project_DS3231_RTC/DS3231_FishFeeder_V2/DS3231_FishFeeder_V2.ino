//static const unsigned char image_Mati[] = {0xf8,0xff,0xff,0xff,0xff,0xff,0x00,0x06,0x00,0x00,0x00,0x00,0x00,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0xff,0x00};
//static const unsigned char image_Hidup[] = {0xf8,0xff,0xff,0xff,0xff,0xff,0x00,0xfe,0xff,0xff,0xff,0xff,0xff,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0xff,0x00};
//static const unsigned char image_Layout[] = {0x00,0x00,0x00,0x00,0x00,0x00,0x00,0x02,0x00,0x00,0x00,0x00,0x00,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0xff,0xff};

#include <Arduino.h>

//uncomment to Debug
#define DEBUG

#ifdef DEBUG
  #define DEBUG_PRINT(...) Serial.print(__VA_ARGS__)
  #define DEBUG_PRINTLN(...) Serial.println(__VA_ARGS__)
  #define DEBUG_BEGIN(baud) Serial.begin(baud)
#else
  #define DEBUG_PRINT(...)    // Do nothing
  #define DEBUG_PRINTLN(...)  // Do nothing
  #define DEBUG_BEGIN(baud)   // Do nothing
#endif

/*------------------------ PIN SETUP - CHANGE AS NEEDED -----------------------------------*/
uint8_t buz = 11;
uint8_t lamp = 5;
uint8_t PushButton = 7;
uint8_t servoPin = 6;

//uint32_t secMil = 0;
//uint8_t seconds = 0;
//bool cnt = true;
uint8_t maxPwm = 100;
uint8_t pos = 0;

//----------------------------- U8G2 OLED Display ---------------------------//
#include <U8g2lib.h>
#include <SPI.h>

U8G2_SSD1306_128X64_NONAME_F_4W_SW_SPI u8g2(U8G2_R0, /* clock=*/ 8, /* data=*/ 9, /* cs=*/ U8X8_PIN_NONE, /* dc=*/ 12, /* reset=*/ 10);

/*---------------------------------- SERVO -----------------------------------*/
#include <Servo.h>
Servo myservo;

/*---------------------------------- DS3231 -----------------------------------*/
#include <DS3231.h>
DS3231 rtc(SDA,SCL);
String waktu;

/*-------------------------------- PUSH BUTTON -----------------------------------*/
#include "OneButton.h"
OneButton pb(PushButton, false, false);  //(Pb_Pin;  true = ActiveLow;  true = button PullUp)


void setup() {
  DEBUG_BEGIN(115200);
  rtc.begin();
  u8g2.begin();
  
  pinMode(buz,OUTPUT);
  pinMode(lamp,OUTPUT);
  
  pb.attachClick(singleClick);
  pb.attachDoubleClick(doubleClick); 
  
  myservo.attach(servoPin);
  myservo.write(95);
  delay(500);
  myservo.detach();
  
//  tone(buz, 2000); delay(2000); noTone(buz);  
}

void loop() {
  pb.tick();
  
  static unsigned long lastMillis = 0;  // Stored in function’s memory, not global memory
 
  if(millis() - lastMillis >= 1000){
    lastMillis = millis();
    
    waktu=rtc.getTimeStr();
    DEBUG_PRINT(rtc.getTimeStr());
    DEBUG_PRINT(" - ");
    DEBUG_PRINTLN(rtc.getDateStr());
        
    u8g2.clearBuffer();
    u8g2.setFontMode(1);
    u8g2.setBitmapMode(1);
    u8g2.setFont(u8g2_font_t0_14b_tr);      //tampilkan jam
    u8g2.drawStr(-1, 12, rtc.getTimeStr());
    u8g2.drawRFrame(-3, -3, 61, 19, 4);
    
    if((millis() / 1000) % 4 < 2){         //efek ganti tanggal dan hari, setiap dua detik
      u8g2.setFont(u8g2_font_t0_13b_tr);   //tampilkan tanggal
      u8g2.drawStr(57, 12, rtc.getDateStr());
    }else{
      u8g2.setFont(u8g2_font_t0_13b_tr);   //tampilkan hari
      u8g2.drawStr(62, 12, rtc.getDOWStr(FORMAT_LONG));
    }
    su8g2.drawRFrame(57, -3, 74, 19, 4);

    u8g2.setFont(u8g2_font_t0_11b_tr);      //buat kotak dan tulisan 'lmapu'
    u8g2.drawStr(18, 28, "LAMPU");
    u8g2.drawRFrame(2, 18, 61, 27, 5);

    u8g2.setFont(u8g2_font_t0_13b_tr);      //print 'hidup'/'mati' berdasarkan lampu
    if(pos >= 100){
      u8g2.drawRBox(7, 30, 51, 13, 5);
      u8g2.setDrawColor(2);
      u8g2.drawStr(15, 41, "HIDUP");
    }else{
      u8g2.drawRFrame(7, 30, 51, 13, 5);
      u8g2.drawStr(18, 41, "MATI");
    }
      
    u8g2.setFont(u8g2_font_t0_11b_tr);      //buat kotak dan tulisan 'pakan'
    u8g2.drawStr(80, 28, "PAKAN");
    u8g2.drawRFrame(65, 18, 61, 27, 5);  
    
    u8g2.drawRFrame(70, 30, 51, 13, 5);     //print 'hidup'/'mati'
    u8g2.setFont(u8g2_font_t0_13b_tr);
    u8g2.drawStr(81, 41, "MATI");
    
    u8g2.setFont(u8g2_font_t0_16b_tr);      // angka kiri bawah
    u8g2.drawStr(21, 60, "05:30");
    
    u8g2.setFont(u8g2_font_t0_12b_tr);
    u8g2.drawStr(1, 59, "OFF");
    
    u8g2.setFont(u8g2_font_t0_16b_tr);      //angka kiri atas
    u8g2.drawStr(67, 60, "05:30");
    
    u8g2.setFont(u8g2_font_t0_12b_tr);
    u8g2.drawStr(115, 59, "ON");

    if((millis() / 1000) % 2 < 1){               //efek kedip titik dua jam, setiap detik
      u8g2.setDrawColor(2);
      u8g2.drawFrame(16, 6, 2, 2);      
      u8g2.drawFrame(16, 10, 2, 2);
      
      u8g2.drawFrame(37, 6, 2, 2);      
      u8g2.drawFrame(37, 10, 2, 2);      
      u8g2.setDrawColor(1);
    }
    
    u8g2.sendBuffer();
  }
}

void singleClick() {
  if (pos >= 100) {
    DEBUG_PRINTLN("- Lamp Off");
    buzOff();
    for (pos = maxPwm; pos >= 1; pos -= 1) { 
      DEBUG_PRINTLN(pos);
      analogWrite(lamp, pos);
      delay(5);                      
    }
    digitalWrite(lamp, LOW);
  } 
  else{
    DEBUG_PRINTLN("- Lamp On");
    buzOn();
    for (pos = 1; pos <= maxPwm; pos += 1) { 
      DEBUG_PRINTLN(pos);
      analogWrite(lamp, pos);
      delay(5);                      
    }
  }
}


void doubleClick(){
  DEBUG_PRINTLN("- Feeding");
  buzPakan();
  pakan();
} 

void pakan(){
      myservo.attach(servoPin);
      myservo.write(150);              
      delay(350);
      myservo.detach();
      delay(10);

      myservo.attach(servoPin);
      myservo.write(95);              
      delay(500);
      myservo.detach();
//      delay(100); 
}

void buzPakan(){
      tone(buz, 261); delay(100);
      tone(buz, 329); delay(100);
      tone(buz, 392); delay(100);
      tone(buz, 493); delay(100);
      tone(buz, 523); delay(100);
      noTone(buz);
//      delay(100);
}

void buzOn(){
      tone(buz, 261); delay(200);
      tone(buz, 329); delay(200);
      tone(buz, 392); delay(200);
      tone(buz, 493); delay(200);
      tone(buz, 523); delay(200);
      noTone(buz);
//      delay(100);
}

void buzOff(){
      tone(buz, 523); delay(200);
      tone(buz, 493); delay(200);
      tone(buz, 392); delay(200);
      tone(buz, 329); delay(200);
      tone(buz, 261); delay(200);
      noTone(buz);
//      delay(100);
}



//    u8g2.setFont(u8g2_font_t0_14b_tr);
//    u8g2.drawStr(-1, 12, rtc.getTimeStr());
//    
//    u8g2.drawRFrame(-5, -5, 63, 21, 6);
    
//    if (seconds % 2 == 0){
//      u8g2.setDrawColor(2);
//      u8g2.drawFrame(16, 10, 2, 2);
//      u8g2.drawFrame(16, 6, 2, 2);
//      u8g2.drawFrame(37, 6, 2, 2);
//      u8g2.drawFrame(37, 10, 2, 2);
//    }
    
//    u8g2.setFont(u8g2_font_t0_13b_tr);
//    if (seconds % 4 < 2){
//      u8g2.drawStr(57, 12, rtc.getDateStr());
//    }else{      
//      u8g2.drawStr(57, 12, rtc.getDOWStr(FORMAT_LONG));
//    }
    
//    u8g2.drawRFrame(57, -5, 76, 21, 6);
//    
//    u8g2.setFont(u8g2_font_t0_11b_tr);
//    u8g2.drawStr(18, 28, "LAMPU");
//    
//    u8g2.drawRFrame(2, 18, 61, 27, 3);
//
//    if(!cnt){
//      u8g2.drawRBox(7, 30, 51, 13, 3);
//      u8g2.setDrawColor(2);
//      u8g2.setFont(u8g2_font_t0_13b_tr);
//      u8g2.drawStr(15, 41, "HIDUP");
//    }else{
//      u8g2.drawRFrame(7, 30, 51, 13, 3);
//      u8g2.setFont(u8g2_font_t0_13b_tr);
//      u8g2.drawStr(18, 41, "MATI");
//    }m
