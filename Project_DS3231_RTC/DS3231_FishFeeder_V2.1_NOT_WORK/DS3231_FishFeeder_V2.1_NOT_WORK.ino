
#include <Arduino.h>

//uncomment to Debug
#define DEBUG

#ifdef DEBUG
  #define DEBUG_PRINT(...) Serial.print(__VA_ARGS__)
  #define DEBUG_PRINTLN(...) Serial.println(__VA_ARGS__)
  #define DEBUG_BEGIN(baud) Serial.begin(baud)
#else
  #define DEBUG_PRINT(...)    // Do nothing
  #define DEBUG_PRINTLN(...)  // Do nothing
  #define DEBUG_BEGIN(baud)   // Do nothing
#endif

/*------------------------ PIN SETUP - CHANGE AS NEEDED -----------------------------------*/
uint8_t buz = 11;
uint8_t lamp = 5;
uint8_t PushButton = 7;
uint8_t servoPin = 6;

uint8_t pos = 0;
uint8_t maxPwm = 200;

//----------------------------- U8G2 OLED Display ---------------------------//
#include <U8g2lib.h>
#include <SPI.h>

U8G2_SSD1306_128X64_NONAME_F_4W_SW_SPI u8g2(U8G2_R0, /* clock=*/ 8, /* data=*/ 9, /* cs=*/ U8X8_PIN_NONE, /* dc=*/ 12, /* reset=*/ 10);

static const unsigned char image_Mati[] U8X8_PROGMEM = {0xf8,0xff,0xff,0xff,0xff,0xff,0x00,0x06,0x00,0x00,0x00,0x00,0x00,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0xff,0x00};
static const unsigned char image_Hidup[] U8X8_PROGMEM = {0xf8,0xff,0xff,0xff,0xff,0xff,0x00,0xfe,0xff,0xff,0xff,0xff,0xff,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0xff,0x00};
static const unsigned char image_Layout[] U8X8_PROGMEM = {0x00,0x00,0x00,0x00,0x00,0x00,0x00,0x02,0x00,0x00,0x00,0x00,0x00,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0xff,0xff};
static const unsigned char image_titikDua[] U8X8_PROGMEM = {0x03,0x03,0x00,0x00,0x03,0x03};
/*---------------------------------- SERVO -----------------------------------*/
#include <Servo.h>
Servo myservo;

/*---------------------------------- DS3231 -----------------------------------*/
#include <DS3231.h>
DS3231 rtc(SDA,SCL);
String waktu;

/*-------------------------------- PUSH BUTTON -----------------------------------*/
#include "OneButton.h"
OneButton pb(PushButton, false, false);  //(Pb_Pin;  true = ActiveLow;  true = button PullUp)


void setup() {
  DEBUG_BEGIN(115200);
  rtc.begin();
  u8g2.begin();
  
  pinMode(buz,OUTPUT);
  pinMode(lamp,OUTPUT);
  
  pb.attachClick(singleClick);
  pb.attachDoubleClick(pakan); 
  
  myservo.attach(servoPin);
  myservo.write(95);
  delay(500);
  myservo.detach();
  
  tone(buz, 2000); delay(2000); noTone(buz);  
}

void loop() {
  pb.tick();
  
  static unsigned long lastMillis = 0;  // Stored in function’s memory, not global memory
  if(millis() - lastMillis >= 1000){    
    waktu=rtc.getTimeStr();
    DEBUG_PRINT(rtc.getTimeStr());
    DEBUG_PRINT(" - ");
    DEBUG_PRINTLN(rtc.getDateStr());

    u8g2.clearBuffer();
    u8g2.setFontMode(1);
    u8g2.setBitmapMode(1);
    
    u8g2.setFont(u8g2_font_t0_14b_tr);
    u8g2.drawStr(-1, 12, rtc.getTimeStr());
    if((millis() / 1000) % 2 < 1){ 
      u8g2.setDrawColor(2); 
      u8g2.drawXBMP(16, 6, 2, 6, image_titikDua); 
      u8g2.setDrawColor(1);
    }
    
    u8g2.setFont(u8g2_font_t0_13b_tr);
    if((millis() / 1000) % 4 < 2) u8g2.drawStr(57, 12, rtc.getDateStr());
    else u8g2.drawStr(62, 12, rtc.getDOWStr(FORMAT_LONG));
    
    
    if(pos >= 100) u8g2.drawXBMP(7, 30, 51, 13, image_Hidup); // lampu
    else u8g2.drawXBMP(7, 30, 51, 13, image_Mati);
    
    u8g2.drawXBMP(71, 30, 51, 13, image_Mati); // pakan
    
    u8g2.drawXBMP(0, 0, 128, 63, image_Layout);
    
    u8g2.sendBuffer();
    lastMillis = millis();
  }

  /*---------------------------PAKAN-------------------------------*/

  if(waktu=="06:30:01"){
      DEBUG_PRINTLN("Morning Feed!!");
      pakan();
    }
  else if(waktu=="18:30:01"){
      DEBUG_PRINTLN("Night Feed!!");
      pakan();
    }

/*-----------------------------LAMPU----------------------------------*/
  
  if(waktu=="05:30:01" or waktu=="17:30:01"){
    DEBUG_PRINTLN("Lamp ON!!");
    lampOn();
  }
  else if(waktu=="07:00:01" or waktu=="20:00:01"){
    DEBUG_PRINTLN("Lamp OFF");
    lampOff();
  }
}



void singleClick() {
  if (pos >= 100) lampOff();
  else lampOn();
}

void pakan(){
  DEBUG_PRINTLN("- Feeding");
  
  tone(buz, 261); delay(100);
  tone(buz, 329); delay(100);
  tone(buz, 392); delay(100);
  tone(buz, 493); delay(100);
  tone(buz, 523); delay(100);
  noTone(buz);
  
  myservo.attach(servoPin);
  myservo.write(150);              
  delay(350);
  myservo.detach();

  myservo.attach(servoPin);
  myservo.write(95);              
  delay(500);
  myservo.detach();
}

void lampOn(){  
    DEBUG_PRINTLN("- Lamp On");
    tone(buz, 261); delay(200);
    tone(buz, 329); delay(200);
    tone(buz, 392); delay(200);
    tone(buz, 493); delay(200);
    tone(buz, 523); delay(200);
    noTone(buz);
    for (pos = 1; pos <= maxPwm; pos += 1) { 
      DEBUG_PRINTLN(pos);
      analogWrite(lamp, pos);
      delay(5);                      
    }
}

void lampOff(){  
    DEBUG_PRINTLN("- Lamp Off");
    tone(buz, 523); delay(200);
    tone(buz, 493); delay(200);
    tone(buz, 392); delay(200);
    tone(buz, 329); delay(200);
    tone(buz, 261); delay(200);
    noTone(buz);
    for (pos = maxPwm; pos >= 1; pos -= 1) { 
      DEBUG_PRINTLN(pos);
      analogWrite(lamp, pos);
      delay(5);                      
    }
    digitalWrite(lamp, LOW);
}
